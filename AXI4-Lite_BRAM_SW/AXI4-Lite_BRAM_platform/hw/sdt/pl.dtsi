/ {
	amba_pl: amba_pl {
		ranges;
		compatible = "simple-bus";
		#address-cells = <1>;
		#size-cells = <1>;
		firmware-name = "design_1_wrapper.bit.bin";
		clocking0: clocking0 {
			compatible = "xlnx,fclk";
			assigned-clocks = <&clkc 15>;
			assigned-clock-rates = <100000000>;
			#clock-cells = <0>;
			clock-output-names = "fabric_clk";
			clocks = <&clkc 15>;
		};
		lab13_matbi_0: lab13_matbi@40000000 {
			compatible = "xlnx,lab13-matbi-1.0";
			xlnx,mem0-data-width = <32>;
			xlnx,mem0-mem-depth = <512>;
			xlnx,s00-axi-data-width = <32>;
			xlnx,ip-name = "lab13_matbi";
			reg = <0x40000000 0x1000>;
			clocks = <&clkc 15>;
			xlnx,cnt-bit = <31>;
			xlnx,edk-iptype = "PERIPHERAL";
			xlnx,mem0-addr-width = <9>;
			status = "okay";
			clock-names = "s00_axi_aclk";
			xlnx,s00-axi-addr-width = <6>;
			xlnx,name = "lab13_matbi_0";
		};
	};
};
